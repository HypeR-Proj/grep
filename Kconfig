## Kconfig
```kconfig
# SPDX-FileCopyrightText: 2026 roolrz
# SPDX-License-Identifier: Apache-2.0

config SYSTEM_APP_GREP
    bool "grep (/bin/grep)"
    default y
    help
        Build and deploy hyper-grep at /bin/grep.
```
